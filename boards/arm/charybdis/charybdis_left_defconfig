## boards/arm/charybdis/charybdis_left_defconfig
```kconfig
# SPDX-License-Identifier: MIT

CONFIG_SOC_SERIES_NRF52X=y
CONFIG_SOC_NRF52840_QIAA=y
CONFIG_BOARD_CHARYBDIS_LEFT=y

#CONFIG_ZMK_SLEEP=y
#CONFIG_ZMK_IDLE_SLEEP_TIMEOUT=1200000
#CONFIG_ZMK_PM_SOFT_OFF=y

CONFIG_ZMK_SPLIT_BLE_CENTRAL_BATTERY_LEVEL_FETCHING=y
CONFIG_ZMK_SPLIT_BLE_CENTRAL_BATTERY_LEVEL_PROXY=y
CONFIG_ZMK_BATTERY_REPORT_INTERVAL=600

#CONFIG_ZMK_USB_LOGGING=y
#CONFIG_LOG_MODE_IMMEDIATE=n
#CONFIG_LOG_PROCESS_THREAD_STARTUP_DELAY_MS=8000
#CONFIG_ZMK_LOG_LEVEL_DBG=y
#CONFIG_KSCAN_LOG_LEVEL_INF=y
#CONFIG_SPI_LOG_LEVEL_DBG=y
#CONFIG_BATTERY_LOG_LEVEL_DBG=y

CONFIG_ZMK_BLE_EXPERIMENTAL_CONN=y

CONFIG_BT_CTLR_TX_PWR_PLUS_8=y

CONFIG_ARM_MPU=y

CONFIG_GPIO=y

CONFIG_USE_DT_CODE_PARTITION=y
CONFIG_BUILD_OUTPUT_UF2=y

CONFIG_MPU_ALLOW_FLASH_WRITE=y
CONFIG_NVS=y
CONFIG_SETTINGS_NVS=y
CONFIG_FLASH=y
CONFIG_FLASH_PAGE_LAYOUT=y
CONFIG_FLASH_MAP=y

CONFIG_CLOCK_CONTROL_NRF=y
CONFIG_CLOCK_CONTROL_NRF_K32SRC_XTAL=y
CONFIG_CLOCK_CONTROL_NRF_K32SRC_20PPM=y

CONFIG_INPUT=y
CONFIG_ZMK_POINTING=y
CONFIG_ZMK_POINTING_SMOOTH_SCROLLING=y

CONFIG_ZMK_USB=n

CONFIG_ZMK_EXT_POWER=n

CONFIG_BT_GATT_ENFORCE_SUBSCRIPTION=n

CONFIG_ZMK_SPLIT_BLE_PREF_INT=9
CONFIG_ZMK_SPLIT_BLE_PREF_LATENCY=16
CONFIG_ZMK_SPLIT_BLE_PREF_TIMEOUT=400

CONFIG_BT_BUF_ACL_TX_COUNT=32
CONFIG_BT_L2CAP_TX_BUF_COUNT=32

# Enable Underglow
CONFIG_ZMK_RGB_UNDERGLOW=y
CONFIG_WS2812_STRIP=y
CONFIG_ZMK_RGB_UNDERGLOW_EXT_POWER=y
CONFIG_ZMK_RGB_UNDERGLOW_AUTO_OFF_IDLE=n
CONFIG_ZMK_RGB_UNDERGLOW_ON_START=y
CONFIG_ZMK_RGB_UNDERGLOW_HUE_START=282
CONFIG_ZMK_RGB_UNDERGLOW_SAT_START=15
CONFIG_ZMK_RGB_UNDERGLOW_BRT_START=5
CONFIG_ZMK_RGB_UNDERGLOW_SPD_START=1
CONFIG_ZMK_RGB_UNDERGLOW_EFF_START=1
```
